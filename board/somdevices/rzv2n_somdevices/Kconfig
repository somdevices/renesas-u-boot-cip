## board/somdevices/rzv2n_somdevices/Kconfig
```kconfig
if TARGET_RZV2N_SOMDEVICES

config SYS_SOC
	default "renesas"

config SYS_BOARD
	default "rzv2n-somdevices"

config SYS_VENDOR
	default "somdevices"

config SYS_CONFIG_NAME
	default "rzv2n-somdevices"

endif
```
